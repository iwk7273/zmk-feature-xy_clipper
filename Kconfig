## Kconfig
```kconfig
menuconfig XY_CLIPPER
    bool "Enable XY Clipper Module"
    default n
    help
        Enable the XY Clipper module for ZMK.

if XY_CLIPPER

config ZMK_INPUT_PROCESSOR_XY_CLIPPER
    bool "Enable XY Clipper Input Processor"
    default y
    depends on ZMK_INPUT_PROCESSORS
    help
      Enable an input processor that zeroes the smaller of X or Y input values.

endif # XY_CLIPPER
```

## dts/bindings/input_processors/zmk,input-processor-xy-clipper.yaml
```yaml
description: ZMK input processor that zeroes the smaller of X or Y motion

compatible: "zmk,input-processor-xy-clipper"

include: ip_zero_param.yaml

properties:
  threshold:
    type: int
    required: false
    description: "Ignore input values whose magnitude is below this threshold."

  invert-x:
    type: int
    required: false
    description: "Invert the sign of X input values."

  invert-y:
    type: int
    required: false
    description: "Invert the sign of Y input values."
```

## west.yml
```yaml
manifest:
  remotes:
    - name: iwk7273
      url-base: https://github.com/iwk7273
  projects:
    - name: zmk-feature-xy_clipper
      remote: iwk7273
      import: west.yml
```
